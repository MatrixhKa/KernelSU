## kernel/Kconfig
```kconfig
menu "KernelSU"

config KSU
	bool "KernelSU function support"
	depends on !CPU_BIG_ENDIAN
	depends on SECURITY_SELINUX
	select SECCOMP
	default y
	help
	  Enable kernel-level root privileges on Android System.

config KSU_FEATURE_SULOG
	bool "KernelSU SU Logging feature"
	depends on KSU
	default y
	help
	  Build KernelSU's SU Log.

config KSU_FEATURE_ADBROOT
	bool "KernelSU ADB Root feature"
	depends on KSU
	default y
	help
	  Build KernelSU's adb root feature.

config KSU_DEBUG
	bool "KernelSU debug mode"
	depends on KSU
	default n
	help
	  Enable KernelSU debug mode.

config KSU_LSM_SECURITY_HOOKS
	bool "Use LSM security hooks"
        depends on KSU
        default y
	help
	  Disabling this is mostly useful for kernel > 6.8.
	  Make sure to implement manual hooks on security/security.c.

config KSU_TOOLKIT
	bool "Enable toolkit support"
	depends on KSU
	default y
	help
	  Enable toolkit support for advanced tweaking.

endmenu
```
